## device/week10/Kconfig
```kconfig
mainmenu "Adaptive Split Inference Week 10 measurements"

choice WEEK10_VARIANT
	prompt "Week 10 firmware variant (W10-D4)"
	default WEEK10_BLE_USB

config WEEK10_BLE_USB
	bool "ble-usb: USB CDC + BLE: VERIFY, ONE, SESSION dry run against the KV260 (TC2)"

config WEEK10_BLE
	bool "ble: automatic PPK2 session at every s with the radio on, no USB/console/log/LED/NVS (TC7)"

endchoice

config WEEK10_CYCLE_GAP_MS
	int "Connected idle between the end of one cycle and the next CTRL (ms, W10-D4)"
	range 0 10000
	default 1000

config WEEK10_BOOT_IDLE_S
	int "Idle window after the boot self-test, radio off (W7-D3, TC3 I_idle)"
	default 30

config WEEK10_CONNECTED_IDLE_S
	int "Connected idle before the first cycle (s)"
	default 30

config WEEK10_SETTLE_S
	int "Wait after the link is ready and the parameters are requested (s)"
	default 5

config WEEK10_SELFTEST_MS
	int "Width of each marker pulse in the boot self-test D0..D4"
	default 200

config WEEK10_CTRL_MIN_US
	int "Minimum CTRL pulse width so 100 kS/s sampling sees it (stub controller)"
	default 200

config WEEK10_RESPONSE_TIMEOUT_MS
	int "WAIT gives up after this long without a valid response (no retry)"
	default 5000

config WEEK10_CONN_INTERVAL_1250US
	int "Connection interval requested from the central, 1.25 ms units, 0 = do not ask (W7-D7: 15 ms)"
	range 0 3200
	default 12

source "Kconfig.zephyr"
```

## device/week10/prot/Kconfig
```kconfig
mainmenu "Adaptive Split Inference Week 10 E_prot measurement"

choice WEEK10_PROT_VARIANT
	prompt "Week 10 E_prot firmware variant (W10-D1)"
	default WEEK10_PROT_USB

config WEEK10_PROT_USB
	bool "prot-usb: USB CDC, radio off, NVS nonce: VERIFY, TPROT, ONE, SESSION dry run (TC2)"

config WEEK10_PROT
	bool "prot: automatic PPK2 E_prot session, no radio/USB/console/log/LED (TC1, TC4)"

endchoice

config WEEK10_CYCLE_GAP_MS
	int "Idle between the end of one cycle and the next CTRL (ms, W10-D1)"
	range 0 10000
	default 1000

config WEEK10_BOOT_IDLE_S
	int "Idle window after the boot self-test (W7-D3, TC3 I_idle)"
	default 30

config WEEK10_SELFTEST_MS
	int "Width of each marker pulse in the boot self-test D0..D4"
	default 200

config WEEK10_CTRL_MIN_US
	int "Minimum CTRL pulse width so 100 kS/s sampling sees it (stub controller)"
	default 200

source "Kconfig.zephyr"
```

## device/week6/Kconfig
```kconfig
mainmenu "Adaptive Split Inference Week 6 Device-Edge BLE"
source "Kconfig.zephyr"
```

## device/week7/Kconfig
```kconfig
mainmenu "Adaptive Split Inference Week 7 energy measurement"

choice WEEK7_VARIANT
	prompt "Week 7 firmware variant"
	default WEEK7_ENERGY_USB

config WEEK7_BENCH
	bool "bench: USB CDC, both FP32 kernels (CMP/MIX/BENCH), no radio (TC7)"

config WEEK7_ENERGY_USB
	bool "energy-usb: measurement cycle over BLE with USB CDC debug output (TC4, dry runs)"

config WEEK7_ENERGY
	bool "energy: automatic PPK2 session, no USB/console/log/LED (TC1, TC5, TC6)"

endchoice

choice WEEK7_KERNEL
	prompt "Head kernel used by the measurement cycle (decision W7-D8)"
	default WEEK7_KERNEL_FAST

config WEEK7_KERNEL_FAST
	bool "optimized FP32 kernel (week7/head_fast.c)"

config WEEK7_KERNEL_WEEK4
	bool "week 4 reference kernel (src/week4_head.c)"

endchoice

config WEEK7_SPLIT
	int "Fixed split point s of the measurement cycle (W7-D9)"
	range 0 10
	default 2

config WEEK7_P1_CYCLES
	int "Cycles with rho = P1 (I2/1 protect), run first"
	range 0 1000
	default 50

config WEEK7_P0_CYCLES
	int "Cycles with rho = P0 (plain), run after the P1 cycles"
	range 0 1000
	default 50

config WEEK7_CYCLE_GAP_MS
	int "Connected idle between two cycles (ms)"
	default 1000

config WEEK7_BOOT_IDLE_S
	int "Idle window after the boot self-test, radio off (W7-D3)"
	default 30

config WEEK7_CONNECTED_IDLE_S
	int "Connected idle before the first cycle (s)"
	default 30

config WEEK7_SETTLE_S
	int "Wait after the link is ready and the parameters are requested (s)"
	default 5

config WEEK7_SELFTEST_MS
	int "Width of each marker pulse in the boot self-test D0..D4 (TC1)"
	default 200

config WEEK7_CTRL_MIN_US
	int "Minimum CTRL pulse width so 100 kS/s sampling sees it (stub controller)"
	default 200

config WEEK7_RESPONSE_TIMEOUT_MS
	int "WAIT gives up after this long without a valid response (no retry in week 7)"
	default 5000

config WEEK7_CONN_INTERVAL_1250US
	int "Connection interval requested from the central, 1.25 ms units, 0 = do not ask (W7-D7)"
	range 0 3200
	default 12

source "Kconfig.zephyr"
```

## device/week9/Kconfig
```kconfig
mainmenu "Adaptive Split Inference Week 9 E_dev(s) measurement"

choice WEEK9_VARIANT
	prompt "Week 9 firmware variant (W9-D5)"
	default WEEK9_DEV_USB

config WEEK9_DEV_USB
	bool "dev-usb: USB CDC, no radio: VERIFY ALL, TDEV, ONE, SESSION dry run (TC2)"

config WEEK9_DEV
	bool "dev: automatic PPK2 E_dev session, no radio/USB/console/log/LED/NVS (TC4)"

endchoice

config WEEK9_CYCLE_GAP_MS
	int "Idle between the end of one HEAD and the next CTRL (ms, W9-D4)"
	range 0 10000
	default 1000

config WEEK9_BOOT_IDLE_S
	int "Idle window after the boot self-test (W7-D3, TC3 I_idle)"
	default 30

config WEEK9_SELFTEST_MS
	int "Width of each marker pulse in the boot self-test D0..D4"
	default 200

config WEEK9_CTRL_MIN_US
	int "Minimum CTRL pulse width so 100 kS/s sampling sees it (stub controller)"
	default 200

source "Kconfig.zephyr"
```
